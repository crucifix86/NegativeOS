## Config.in
```kconfig
menu "NegativeOS packages"
    source "$BR2_EXTERNAL_NEGATIVEOS_PATH/package/negativeos-base/Config.in"
endmenu
```

## configs/negativeos_i686_defconfig
```kconfig
# NegativeOS Buildroot config — i686 (32-bit)
# Run: make negativeos_i686_defconfig

# Architecture
BR2_i386=y
BR2_x86_i686=y
BR2_X86_CPU_HAS_MMX=y
BR2_X86_CPU_HAS_SSE=y

# Compiler flags for P4 compatibility
BR2_TARGET_OPTIMIZATION="-march=i686 -mtune=pentium4 -O2 -pipe"

# Toolchain
BR2_TOOLCHAIN_BUILDROOT_GLIBC=y
BR2_TOOLCHAIN_BUILDROOT_CXX=y
BR2_GCC_VERSION_14_X=y

# Kernel
BR2_LINUX_KERNEL=y
BR2_LINUX_KERNEL_LATEST_VERSION=y
BR2_LINUX_KERNEL_USE_DEFCONFIG=y
BR2_LINUX_KERNEL_DEFCONFIG="i386"
BR2_LINUX_KERNEL_BZIMAGE=y

# Init
BR2_INIT_RUNIT=y
BR2_PACKAGE_RUNIT=y

# Core userspace
BR2_PACKAGE_BUSYBOX=y
BR2_PACKAGE_BUSYBOX_SHOW_OTHERS=y
BR2_PACKAGE_UTIL_LINUX=y
BR2_PACKAGE_E2FSPROGS=y
BR2_PACKAGE_DOSFSTOOLS=y

# Bootloader — legacy BIOS only for i686 (P4 has no UEFI)
BR2_TARGET_GRUB2=y
BR2_TARGET_GRUB2_I386_PC=y

# Package manager
BR2_PACKAGE_APK_TOOLS=y

# Xorg + IceWM
BR2_PACKAGE_XORG7=y
BR2_PACKAGE_XSERVER_XORG_SERVER=y
BR2_PACKAGE_ICEWM=y
BR2_PACKAGE_SLIM=y

# Legacy GPU drivers for P4 era
BR2_PACKAGE_XDRIVER_XSERVER_XORG_VIDEO_VESA=y
BR2_PACKAGE_XDRIVER_XSERVER_XORG_VIDEO_SAVAGE=y

# Core apps
BR2_PACKAGE_PCMANFM=y
BR2_PACKAGE_RXVT_UNICODE=y
BR2_PACKAGE_MOUSEPAD=y
BR2_PACKAGE_GPICVIEW=y
BR2_PACKAGE_XARCHIVER=y

# Networking
BR2_PACKAGE_NETWORKMANAGER=y
BR2_PACKAGE_AVAHI=y
BR2_PACKAGE_SAMBA4=y

# Audio
BR2_PACKAGE_PIPEWIRE=y

# Browser
BR2_PACKAGE_PALEMOON=y

# Developer tools (for Claude Code + general dev)
BR2_PACKAGE_NODEJS=y
BR2_PACKAGE_GIT=y
BR2_PACKAGE_CURL=y
BR2_PACKAGE_OPENSSH=y

# Firmware
BR2_PACKAGE_LINUX_FIRMWARE=y
BR2_PACKAGE_NDISWRAPPER=y

# Build options
BR2_OPTIMIZE_2=y
BR2_STRIP_strip=y
BR2_TARGET_ROOTFS_SQUASHFS=y
BR2_TARGET_ROOTFS_CPIO=y
BR2_TARGET_ROOTFS_CPIO_GZIP=y
```

## configs/negativeos_x86_64_defconfig
```kconfig
# NegativeOS Buildroot config — x86_64
# Run: make negativeos_x86_64_defconfig

# Architecture
BR2_x86_64=y
BR2_x86_generic=y
BR2_X86_CPU_HAS_SSE=y
BR2_X86_CPU_HAS_SSE2=y

# Toolchain
BR2_TOOLCHAIN_BUILDROOT_GLIBC=y
BR2_TOOLCHAIN_BUILDROOT_CXX=y
BR2_GCC_VERSION_14_X=y

# Kernel
BR2_LINUX_KERNEL=y
BR2_LINUX_KERNEL_LATEST_VERSION=y
BR2_LINUX_KERNEL_USE_DEFCONFIG=y
BR2_LINUX_KERNEL_DEFCONFIG="x86_64"
BR2_LINUX_KERNEL_BZIMAGE=y

# Init — BusyBox init (runit not in Buildroot 2024.11 as standalone)
BR2_INIT_BUSYBOX=y

# Core userspace
BR2_PACKAGE_BUSYBOX=y
BR2_PACKAGE_BUSYBOX_SHOW_OTHERS=y
BR2_PACKAGE_UTIL_LINUX=y
BR2_PACKAGE_E2FSPROGS=y
BR2_PACKAGE_DOSFSTOOLS=y

# Bootloader
BR2_TARGET_GRUB2=y
BR2_TARGET_GRUB2_I386_PC=y
BR2_TARGET_GRUB2_X86_64_EFI=y

# Xorg + Openbox (IceWM not in Buildroot 2024.11; Openbox is)
BR2_PACKAGE_XORG7=y
BR2_PACKAGE_XSERVER_XORG_SERVER=y
BR2_PACKAGE_XAPP_XINIT=y
BR2_PACKAGE_XAPP_XDM=y
BR2_PACKAGE_XAPP_XSETROOT=y
BR2_PACKAGE_OPENBOX=y
BR2_PACKAGE_XDRIVER_XF86_VIDEO_FBDEV=y
BR2_PACKAGE_XDRIVER_XF86_VIDEO_VESA=y

# Core apps
BR2_PACKAGE_PCMANFM=y
BR2_PACKAGE_XTERM=y

# Networking
BR2_PACKAGE_NETWORKMANAGER=y
BR2_PACKAGE_AVAHI=y
BR2_PACKAGE_SAMBA4=y

# Audio
BR2_PACKAGE_PIPEWIRE=y

# Developer tools
BR2_PACKAGE_NODEJS=y
BR2_PACKAGE_GIT=y
BR2_PACKAGE_CURL=y
BR2_PACKAGE_OPENSSH=y

# Firmware
BR2_PACKAGE_LINUX_FIRMWARE=y

# Build options
# GCC 14 treats incompatible pointer types as errors — suppress for old packages
BR2_TARGET_OPTIMIZATION="-O2 -Wno-incompatible-pointer-types -Wno-int-conversion"
BR2_STRIP_strip=y
BR2_ROOTFS_OVERLAY="$(BR2_EXTERNAL_NEGATIVEOS_PATH)/overlay"
BR2_TARGET_ROOTFS_SQUASHFS=y
BR2_TARGET_ROOTFS_CPIO=y
BR2_TARGET_ROOTFS_CPIO_GZIP=y
```

## package/negativeos-base/Config.in
```kconfig
config BR2_PACKAGE_NEGATIVEOS_BASE
    bool "negativeos-base"
    help
      Meta-package for the full NegativeOS default desktop install.
      Pulls in IceWM, core apps, networking, audio, and driver support.
```

## package/palemoon/Config.in
```kconfig
config BR2_PACKAGE_PALEMOON
    bool "palemoon"
    depends on BR2_i386 || BR2_x86_64
    depends on BR2_INSTALL_LIBSTDCPP
    select BR2_PACKAGE_GTK3
    select BR2_PACKAGE_LIBGTK2
    select BR2_PACKAGE_XLIB_LIBX11
    select BR2_PACKAGE_XLIB_LIBXT
    help
      Pale Moon web browser — Firefox-based, ships official i686
      and x86_64 Linux builds. Default browser for NegativeOS.

      https://www.palemoon.org
```
